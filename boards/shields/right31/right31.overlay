/ {
    chosen {
        zmk,kscan = &kscan0;
    };

    kscan0: kscan_0 {
        compatible = "zmk,kscan-gpio-matrix";
        diode-direction = "row2col";

        row-gpios = <
            &gpio0 17 GPIO_ACTIVE_HIGH
            &gpio0 20 GPIO_ACTIVE_HIGH
            &gpio0 22 GPIO_ACTIVE_HIGH
            &gpio0 24 GPIO_ACTIVE_HIGH
            &gpio1 0 GPIO_ACTIVE_HIGH
        >;

        col-gpios = <
            &gpio0 31 (GPIO_PULL_DOWN | GPIO_ACTIVE_HIGH)
            &gpio0 29 (GPIO_PULL_DOWN | GPIO_ACTIVE_HIGH)
            &gpio0 2  (GPIO_PULL_DOWN | GPIO_ACTIVE_HIGH)
            &gpio1 15 (GPIO_PULL_DOWN | GPIO_ACTIVE_HIGH)
            &gpio1 13 (GPIO_PULL_DOWN | GPIO_ACTIVE_HIGH)
            &gpio1 11 (GPIO_PULL_DOWN | GPIO_ACTIVE_HIGH)
            &gpio1 10 (GPIO_PULL_DOWN | GPIO_ACTIVE_HIGH)
        >;
    };
};
