#include "split_kb.dtsi"

&kscan0 {
    row-gpios = <
        &gpio0 17 GPIO_ACTIVE_HIGH
        &gpio0 20 GPIO_ACTIVE_HIGH
        &gpio0 22 GPIO_ACTIVE_HIGH
        &gpio0 24 GPIO_ACTIVE_HIGH
        &gpio1 4  GPIO_ACTIVE_HIGH
    >;

    col-gpios = <
        &gpio0 9  (GPIO_PULL_DOWN | GPIO_ACTIVE_HIGH)
        &gpio0 29 (GPIO_PULL_DOWN | GPIO_ACTIVE_HIGH)
        &gpio0 2  (GPIO_PULL_DOWN | GPIO_ACTIVE_HIGH)
        &gpio1 6  (GPIO_PULL_DOWN | GPIO_ACTIVE_HIGH)
        &gpio1 13 (GPIO_PULL_DOWN | GPIO_ACTIVE_HIGH)
        &gpio1 11 (GPIO_PULL_DOWN | GPIO_ACTIVE_HIGH)
        &gpio0 10 (GPIO_PULL_DOWN | GPIO_ACTIVE_HIGH)
    >;
};
