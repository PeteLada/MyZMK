#include "split_kb.dtsi"

&kscan0 {
    /* TODO: замени на свои реальные row-пины левой половины */
    row-gpios
        = <&pro_micro 0  (GPIO_ACTIVE_HIGH | GPIO_PULL_DOWN)>
        , <&pro_micro 1  (GPIO_ACTIVE_HIGH | GPIO_PULL_DOWN)>
        , <&pro_micro 2  (GPIO_ACTIVE_HIGH | GPIO_PULL_DOWN)>
        , <&pro_micro 3  (GPIO_ACTIVE_HIGH | GPIO_PULL_DOWN)>
        , <&pro_micro 4  (GPIO_ACTIVE_HIGH | GPIO_PULL_DOWN)>
        ;

    /* TODO: замени на свои реальные col-пины левой половины */
    col-gpios
        = <&pro_micro 5  GPIO_ACTIVE_HIGH>
        , <&pro_micro 6  GPIO_ACTIVE_HIGH>
        , <&pro_micro 7  GPIO_ACTIVE_HIGH>
        , <&pro_micro 8  GPIO_ACTIVE_HIGH>
        , <&pro_micro 9  GPIO_ACTIVE_HIGH>
        , <&pro_micro 10 GPIO_ACTIVE_HIGH>
        , <&pro_micro 16 GPIO_ACTIVE_HIGH>
        ;
};

&default_transform {
    col-offset = <7>;
};
