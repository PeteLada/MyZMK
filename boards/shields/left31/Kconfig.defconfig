## boards/shields/left31/Kconfig.defconfig
```kconfig
if SHIELD_LEFT31

config ZMK_KEYBOARD_NAME
    string
    default "Left31"

endif
```

## boards/shields/right31/Kconfig.defconfig
```kconfig
if SHIELD_RIGHT31

config ZMK_KEYBOARD_NAME
    string
    default "Right31"

endif
```

## boards/shields/split_kb/Kconfig.defconfig
```kconfig
if SHIELD_SPLIT_KB_RIGHT

config ZMK_KEYBOARD_NAME
    default "Split KB"

config ZMK_SPLIT_ROLE_CENTRAL
    default y

endif

if SHIELD_SPLIT_KB_LEFT || SHIELD_SPLIT_KB_RIGHT

config ZMK_SPLIT
    default y

config ZMK_SPLIT_BLE_CENTRAL_PERIPHERALS
    default 1

endif
```
